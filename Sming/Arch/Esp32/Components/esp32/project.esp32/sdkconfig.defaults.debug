## Sming/Arch/Esp32/Components/esp32/project.esp32/sdkconfig.defaults.debug
```kconfig
#
# Espressif IoT Development Framework (ESP-IDF) Project Configuration
#
# SMING DEBUG SETTINGS
#

#
# SDK tool configuration
#

CONFIG_COMPILER_OPTIMIZATION_SIZE=y

# Mandatory LWIP changes
CONFIG_LWIP_TCPIP_TASK_STACK_SIZE=8192

# Ethernet
#CONFIG_ETH_USE_ESP32_EMAC=y
#CONFIG_ETH_PHY_INTERFACE_RMII=y
#CONFIG_ETH_RMII_CLK_INPUT=y
#CONFIG_ETH_RMII_CLK_IN_GPIO=0
CONFIG_ETH_USE_SPI_ETHERNET=n

# Mandatory Sming framework changes
CONFIG_ESP_TIMER_TASK_STACK_SIZE=16384
CONFIG_ESP_SYSTEM_EVENT_TASK_STACK_SIZE=8192
CONFIG_ESP_TIMER_IMPL_FRC2=y

# The bootloader logs all type of messages
CONFIG_BOOTLOADER_LOG_LEVEL_NONE=
CONFIG_BOOTLOADER_LOG_LEVEL_ERROR=
CONFIG_BOOTLOADER_LOG_LEVEL_WARN=
CONFIG_BOOTLOADER_LOG_LEVEL_INFO=y
CONFIG_BOOTLOADER_LOG_LEVEL_DEBUG=
CONFIG_BOOTLOADER_LOG_LEVEL_VERBOSE=
CONFIG_BOOTLOADER_LOG_LEVEL=3

# ESP-IDF logs all type of messages
CONFIG_LOG_DEFAULT_LEVEL_NONE=
CONFIG_LOG_DEFAULT_LEVEL_ERROR=
CONFIG_LOG_DEFAULT_LEVEL_WARN=
CONFIG_LOG_DEFAULT_LEVEL_INFO=y
CONFIG_LOG_DEFAULT_LEVEL_DEBUG=
CONFIG_LOG_DEFAULT_LEVEL_VERBOSE=
CONFIG_LOG_DEFAULT_LEVEL=3

# Sets watchpoint index 1 (the second of two) at the end of any task stack. This is the most accurate way to debug task stack overflows.
CONFIG_FREERTOS_WATCHPOINT_END_OF_STACK=y
```

## Sming/Arch/Esp32/Components/esp32/project.esp32/sdkconfig.defaults.release
```kconfig
#
# Espressif IoT Development Framework (ESP-IDF) Project Configuration
#
# SMING RELEASE SETTINGS
#

#
# SDK tool configuration
#

CONFIG_COMPILER_OPTIMIZATION_SIZE=y

# Mandatory LWIP changes
CONFIG_LWIP_TCPIP_TASK_STACK_SIZE=8192
CONFIG_ESP_NETIF_TCPIP_ADAPTER_COMPATIBLE_LAYER=n

# Ethernet
#CONFIG_ETH_USE_ESP32_EMAC=y
#CONFIG_ETH_PHY_INTERFACE_RMII=y
#CONFIG_ETH_RMII_CLK_INPUT=y
#CONFIG_ETH_RMII_CLK_IN_GPIO=0
CONFIG_ETH_USE_SPI_ETHERNET=n

# Mandatory Sming framework changes
CONFIG_ESP_TIMER_TASK_STACK_SIZE=16384
CONFIG_ESP_SYSTEM_EVENT_TASK_STACK_SIZE=8192
CONFIG_ESP_TIMER_IMPL_FRC2=y

# The bootloader logs only errors
CONFIG_BOOTLOADER_LOG_LEVEL_NONE=
CONFIG_BOOTLOADER_LOG_LEVEL_ERROR=y
CONFIG_BOOTLOADER_LOG_LEVEL_WARN=
CONFIG_BOOTLOADER_LOG_LEVEL_INFO=
CONFIG_BOOTLOADER_LOG_LEVEL_DEBUG=
CONFIG_BOOTLOADER_LOG_LEVEL_VERBOSE=
CONFIG_BOOTLOADER_LOG_LEVEL=1

# ESP-IDF logs only errors
CONFIG_LOG_DEFAULT_LEVEL_NONE=
CONFIG_LOG_DEFAULT_LEVEL_ERROR=y
CONFIG_LOG_DEFAULT_LEVEL_WARN=
CONFIG_LOG_DEFAULT_LEVEL_INFO=
CONFIG_LOG_DEFAULT_LEVEL_DEBUG=
CONFIG_LOG_DEFAULT_LEVEL_VERBOSE=
CONFIG_LOG_DEFAULT_LEVEL=1
```

## Sming/Arch/Esp32/Components/esp32/project.esp32c3/sdkconfig.defaults.debug
```kconfig
#
# Espressif IoT Development Framework (ESP-IDF) Project Configuration
#
# SMING DEBUG SETTINGS
#

#
# SDK tool configuration
#

# Mandatory LWIP changes
CONFIG_LWIP_TCPIP_TASK_STACK_SIZE=8192
CONFIG_ESP_NETIF_TCPIP_ADAPTER_COMPATIBLE_LAYER=n

# Mandatory Sming framework changes
CONFIG_ESP_TIMER_TASK_STACK_SIZE=16384
CONFIG_ESP_SYSTEM_EVENT_TASK_STACK_SIZE=8192

# The bootloader logs all type of messages
CONFIG_BOOTLOADER_LOG_LEVEL_NONE=
CONFIG_BOOTLOADER_LOG_LEVEL_ERROR=
CONFIG_BOOTLOADER_LOG_LEVEL_WARN=
CONFIG_BOOTLOADER_LOG_LEVEL_INFO=y
CONFIG_BOOTLOADER_LOG_LEVEL_DEBUG=
CONFIG_BOOTLOADER_LOG_LEVEL_VERBOSE=
CONFIG_BOOTLOADER_LOG_LEVEL=3

# ESP-IDF logs all type of messages
CONFIG_LOG_DEFAULT_LEVEL_NONE=
CONFIG_LOG_DEFAULT_LEVEL_ERROR=
CONFIG_LOG_DEFAULT_LEVEL_WARN=
CONFIG_LOG_DEFAULT_LEVEL_INFO=y
CONFIG_LOG_DEFAULT_LEVEL_DEBUG=
CONFIG_LOG_DEFAULT_LEVEL_VERBOSE=
CONFIG_LOG_DEFAULT_LEVEL=3

# Sets watchpoint index 1 (the second of two) at the end of any task stack. This is the most accurate way to debug task stack overflows.
CONFIG_FREERTOS_WATCHPOINT_END_OF_STACK=y
```

## Sming/Arch/Esp8266/Components/driver/Kconfig
```kconfig
menu "Drivers"
    config USE_US_TIMER
        bool "Enable microsecond precision for software timers (Timer2)"
        help
            The following functions depend on Timer2:
            - NOW() return value, the Timer2 tick count
            - Software timers
            - System time

            Software timers are driven by Timer2, which by default uses a /256 prescale
            providing a resolution of 3.2us and a range of 1' 54".

            Enabling this setting increases the resolution to 200ns but reduces the maximum
            software timer to 7" 9.5s.

    config ENABLE_CUSTOM_PWM
        bool "Use the *New PWM* driver"
        default y
        help
            New PWM is a drop-in replacement for the version provided in the Espressif SDK.

endmenu
```

## Sming/Arch/Esp8266/Components/heap/Kconfig
```kconfig
menu "Heap"
    config ENABLE_CUSTOM_HEAP
        bool "Enable custom heap using UMM Malloc"

    if ENABLE_CUSTOM_HEAP

        config UMM_POISON_CHECK
            bool "UMM Poison Check"
            help
                Add heap integrity checks

        config UMM_FUNC_IRAM
            bool "Store custom heap functions in IRAM"
            default y
            help
                Custom heap functions are stored in IRAM by default for performance reasons.
                If you need the IRAM (about 1.5K bytes) then disable this option.

    endif
endmenu
```

## Sming/Arch/Rp2040/Components/rp2040/Kconfig
```kconfig
menu "RP2040 Core"
    config PICO_BOARD
        bool "Development board in use"
        default pico
        help
            If using custom hardware, select ``none``.
            List available boards with ``make board-list``.

    config ENABLE_BOOTSEL
        bool "Enable BOOTSEL"
        default y if SMING_RELEASE
        help
            Monitor BOOTSEL button and restart in boot mode if pressed.
            Avoids need to power-cycle the board to re-program.
endmenu
```

## Sming/Components/Hosted-Lib/Kconfig
```kconfig
menu "Hosted-Lib"
    depends on !ENABLE_HOSTED

    config ENABLE_HOSTED_DIGITAL
    	bool "Proxy Digital.h commands"
    	default y
    	
    config ENABLE_HOSTED_WIRE
    	bool "Proxy Wire.h commands"
    	default y

endmenu
```

## Sming/Components/Hosted/Kconfig
```kconfig
menu "Hosted"
    choice
        depends on SMING_ARCH="Host"
        default ENABLE_HOSTED_NONE
        prompt "Hosted transport mechanism"
        config ENABLE_HOSTED_NONE
            bool "None"
        config ENABLE_HOSTED_TCP
            bool "TCP"
        config ENABLE_HOSTED_SERIAL
            bool "Serial"
    endchoice

    config ENABLE_HOSTED
        string
        default "" if ENABLE_HOSTED_NONE
        default "tcp" if ENABLE_HOSTED_TCP
        default "serial" if ENABLE_HOSTED_SERIAL

    if ENABLE_HOSTED="tcp"
        config HOSTED_SERVER_IP
            depends on ENABLE_HOSTED="tcp"
            string "Remote RPC server IP address"
            default "192.168.13.1"
    endif

    if ENABLE_HOSTED="serial"
        config HOSTED_COM_PORT
            string "COM port connected to remote RPC server"
            default "$(COM_PORT)"

        config HOSTED_COM_SPEED
            int "Baud rate for hosted COM port"
            default 115200
    endif

endmenu
```

## Sming/Components/Hosted/samples/tcp/Kconfig
```kconfig
menu "Hosted TCP sample"
    config CONNECT_TO_WIFI
        bool "Connect to WiFi access point"
        help
            Make sure to provide WIFI_SSID and WIFI_PWD values

endmenu
```

## Sming/Components/Network/Kconfig
```kconfig
menu "Network"
    depends on !DISABLE_NETWORK

    config DISABLE_WIFI
        bool "Build without WiFi support"
        default n
        help
            Keeps the core Network library but excludes WiFi code.
            Applications using ethernet can use this to reduce code size.

    if !DISABLE_WIFI
        config WIFI_SSID
            string "Default WiFi SSID"
            depends on !DISABLE_WIFI

        config WIFI_PWD
            string "Default WiFi Passphrase"
            depends on !DISABLE_WIFI

        if SMING_ARCH=Esp8266
            config ENABLE_WPS
                bool "Enable WiFi Protected Setup (WPS)"
                help
                    WPS is not enabled by default to preserve resources, and because
                    there may be security implications which you should consider carefully.

            config ENABLE_SMART_CONFIG
                bool "Enable WiFi Smart Configuration API"
                help
                    See :sample:`Basic_SmartConfig` sample application.
        endif
    endif

    config HTTP_SERVER_EXPOSE_NAME
        bool "Add \"HttpServer/Sming\" to the SERVER field in response headers"
        default y
        help
               If disabled, the SERVER field is omitted from all responses.

    config HTTP_SERVER_EXPOSE_VERSION
        bool "Include Sming version in HTTP server headers"
        depends on HTTP_SERVER_EXPOSE_NAME
        help
            Adds the current Sming build version to the SERVER field in response headers.
            For example, "Sming/4.0.0-rc2".

    config ENABLE_CUSTOM_LWIP
        int "LWIP version (0 for SDK, 1 or 2)"
        range 0 2
        default 1
        depends on SMING_ARCH=Esp8266

endmenu
```

## Sming/Components/esptool/Kconfig
```kconfig
menu "esptool"
   config COM_PORT_ESPTOOL
      string "Port to use for flashing device"
      default COM_PORT

   config COM_SPEED_ESPTOOL
      string "Baud rate to use for flashing device"
      default COM_SPEED
endmenu
```

## Sming/Components/rboot/Kconfig
```kconfig
menu "rBoot"
    depends on SMING_ARCH = "Esp8266"

    config RBOOT_RTC_ENABLED
        bool "Enable extended boot information via RTC memory"

    choice
        prompt "GPIO boot behaviour"
        default RBOOT_GPIO_DISABLED
        config RBOOT_GPIO_DISABLED
            bool "Disable GPIO features"
        config RBOOT_GPIO_ENABLED
            bool "Enable GPIO boot slot 2"
            help
                rBoot supports booting into a third slot upon explicit user request,
                e.g. by pressing a button during reset/power up.
                This is especially useful for implementing some sort of recovery mechanism.
        config RBOOT_GPIO_SKIP_ENABLED
            bool "Use GPIO to skip between boot roms"
    endchoice

endmenu
```

## Sming/Components/ssl/Kconfig
```kconfig
menu "SSL"
	depends on !DISABLE_NETWORK

	choice
		default SELECT_SSL_NONE
		prompt "SSL adapter"
		config SELECT_SSL_NONE
			bool "None"
		config SELECT_SSL_DEFAULT
			bool "Default (Axtls)"
		config SELECT_SSL_AXTLS
			bool "AXTLS"
		config SELECT_SSL_BEARSSL
			bool "Bear SSL"
	endchoice

	config ENABLE_SSL
		string
		default "0" if SELECT_SSL_NONE
		default "1" if SELECT_SSL_DEFAULT
		default "Axtls" if SELECT_SSL_AXTLS
		default "Bearssl" if SELECT_SSL_BEARSSL

	config SSL_DEBUG
		depends on ENABLE_SSL != "0"
		bool "Enable SSL debug"

endmenu
```

## Sming/Components/terminal/Kconfig
```kconfig
menu "Terminal"

   config COM_PORT
      string "Default port for device communications"
      help
         Default value depends on the development platform being used.
      default "/dev/cuaU0" if ("$UNAME" = "FreeBSD")
      default "/dev/tty.usbserial" if "$UNAME" = "MacOS"
      default "/dev/ttyUSB0" if "$UNAME" = "Linux"
      default "COM3" if "$UNAME" = "Windows"

   config COM_SPEED_SERIAL
      int "Default baud rate to use for serial communication within application"
      default COM_SPEED

   config COM_OPTS
      string "Additional options to pass to the terminal"
      default "--raw --encoding ascii --rts 0 --dtr 0"

   config TERMINAL
      string "Command line to use when running `make terminal`"
      help
         Redefine if you want to use a different terminal application
      default "powershell.exe -Command \"python -m serial.tools.miniterm $(COM_OPTS) $(COM_PORT) $(COM_SPEED_SERIAL)\"" if $WSL_ROOT
      default "$(PYTHON) -m serial.tools.miniterm $(COM_OPTS) $(COM_PORT) $(COM_SPEED_SERIAL)" if !$WSL_ROOT

   config KILL_TERM
      string "Command line to use to kill the running terminal process"
      help
         If the terminal never runs in the background and the warnings annoy you, just clear it
      default "pkill -9 -f \"$(COM_PORT) $(COM_SPEED_SERIAL)\" || exit 0"

endmenu
```
