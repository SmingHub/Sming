## Sming/Kconfig
```kconfig
#
# For a description of the syntax of this configuration file,
# see kconfig/kconfig-language.txt.
#
mainmenu "${SMING_SOC} Sming Framework Configuration"

    config SMING_ARCH
        string
        option env="SMING_ARCH"

    menu "Sming"
        choice
            default SELECT_LOCALE_EN_GB
            prompt "Date/Time country code"
            help
                Sming can format dates/time values based on a country code identified by this value.
                This is provided as a #define symbol for your application to use.
                See :source:`Sming/Core/SmingLocale.h` for further details.
            config SELECT_LOCALE_EN_US
                bool "English (US)"
            config SELECT_LOCALE_EN_GB
                bool "English (UK)"
            config SELECT_LOCALE_EN_AU
                bool "English (Australia)"
            config SELECT_LOCALE_FR_FR
                bool "Français"
            config SELECT_LOCALE_DE_DE
                bool "Deutsch"
        endchoice

        config LOCALE
            int
            default 1 if SELECT_LOCALE_EN_US
            default 33 if SELECT_LOCALE_FR_FR
            default 44 if SELECT_LOCALE_EN_GB
            default 49 if SELECT_LOCALE_DE_DE
            default 61 if SELECT_LOCALE_EN_AU

        config COM_SPEED
            int "Default baud rate for serial port"
            default 115200
            help
                This will recompile your application to use the revised baud rate.
                Note that this will change the default speed used for both flashing and serial comms.

        config ENABLE_CMD_EXECUTOR
            bool "Enable command executor functionality"
            default y
            help
                This facilty requires documenting!

        config TASK_QUEUE_LENGTH
            int "Length of task queue"
            default 10
            depends on SMING_ARCH="Esp8266" || SMING_ARCH="Host" || SMING_ARCH="Rp2040"

        config STRING_OBJECT_SIZE
            int "Size of a Wiring String object"
            default 12
            help
                Change this to increase space for Small String Optimisation (SSO)

        config DISABLE_NETWORK
            bool "Build without networking support"
            default n
            select DISABLE_WIFI if DISABLE_NETWORK
            help
                Applications which do not require networking can set this flag to avoid building
                or linking the core Network library.

                This will reduce build times, application size and RAM usage.
                Builds will not succeeded if network code has been inadvertently included.
    endmenu

    menu "Debug"
        choice
            default SELECT_DEBUG_INFO
            prompt "Detail level for debug messages"
            config SELECT_DEBUG_ERROR
                bool "0 Errors only"
            config SELECT_DEBUG_WARN
                bool "1 Errors and warnings"
            config SELECT_DEBUG_INFO
                bool "2 Errors, warnings and Information"
            config SELECT_DEBUG_DEBUG
                bool "3 All debug messages"
        endchoice

        config DEBUG_VERBOSE_LEVEL
            int
            default 0 if SELECT_DEBUG_ERROR
            default 1 if SELECT_DEBUG_WARN
            default 2 if SELECT_DEBUG_INFO
            default 3 if SELECT_DEBUG_DEBUG

        config DEBUG_PRINT_FILENAME_AND_LINE
            bool "Include the filename and line number in every line of debug output."
            default n
            help
                This will require extra space on flash

        config ENABLE_GDB
            bool "Compile with support for serial debugging using GDB"

        config ENABLE_SPI_DEBUG
            bool "Enable SPI debug output"

        config ENABLE_TASK_COUNT
            bool "Enable use of System task counting to check for queue overflows"
            depends on SMING_ARCH="Esp8266"
    endmenu

    source "$KCONFIG_COMPONENTS"
```

## Sming/Libraries/OtaUpgrade/Kconfig
```kconfig
menu "OTA Upgrade"

    config ENABLE_OTA_SIGNING
        bool "Protect upgrade files using digital signature"
        default y
        help
            If enabled (highly recommended), OTA upgrade files are protected against unauthorized modification by a digital signature.

            You may disable signing in order to save some program memory if your communication channel already establishes a
            comparable level of trust, e.g. TLS with a pinned certificate.

    config OTA_ENABLE_ENCRYPTION
        bool "Encrypt upgrade files"
        help
            This option helps to protect any confidential data embedded in your firmware, such as WiFi credentials, server certificates, etc.

    config OTA_KEY
        string "Path to secret encryption/signing key"
        default "ota.key"

    config ENABLE_OTA_DOWNGRADE
        bool "Enable downgrade"
        help
            By default, BasicStream refuses to downgrade to an older firmware version to prevent an attacker from restoring already patched security vulnerabilities.

            Downgrade protection must be combined with encryption or signing to be effective.

    config OTA_UPLOAD_URL
        string "URL used by the `make ota-upload` command"


    config OTA_UPLOAD_NAME
        string "Field name for upgrade file in HTTP POST request"
        default "firmware"
        help
            This relates to the `name` attribute of the HTML input element
            used with the `make ota-upload` command:

                <input type="file" name="firmware" />

endmenu
```

## Sming/Libraries/OtaUpgradeMqtt/Kconfig
```kconfig
menu "OTA Upgrade MQTT"

    config ENABLE_OTA_VARINT_VERSION
        bool "Enable 'varint' encoding for patch version"
        default y
        help
            If enabled, the OTA upgrade mechanism and application will use a `varint <https://developers.google.com/protocol-buffers/docs/encoding#varints>`_
            encoding for the patch version. Thus allowing unlimited number of patch versions. Useful for enumerating unstable/nightly releases.
            A bit more difficult to read and write but allows for unlimited versions.

            If set to 0 the OTA upgrade mechanism and application will use one byte for the patch version which will limit it to 256 possible patch versions.
            Useful for enumarating stable releases. Easier to write and read but limited to 256 versions only.

    config ENABLE_OTA_ADVANCED
        bool "Support firmware signing/encryption"
        help
           Enabling this option allows the library to work with OtaUpgradeStream which supports signature and encryption of the firmware data itself.
           In the application the AdvancedPayloadParser can be used to do the MQTT message handling.

endmenu
```

## Sming/Libraries/SPI/Kconfig
```kconfig
menu "SPI Library"
    config SPISOFT_DELAY_VARIABLE
        bool "Variable clock delay"
        default N

    config SPISOFT_DELAY_FIXED
        int "Fixed clock delay"
        default 0
        range 0 12
        depends on !SPISOFT_DELAY_VARIABLE
        help
            Inserts one CPU 'nop' instruction after every SCK transition

    config ENABLE_SPI_DEBUG
        bool "Enable SPI debug output"
        default N

endmenu
```

## Sming/Libraries/SPI/test/Kconfig
```kconfig
menu "SPI Library Tests"
    config SPISOFT_ENABLE
        bool "Test software SPI"
        default Y
        help
            De-select to test hardware SPI

    config SPISOFT_CALIBRATE
        bool "Run software SPI calbration sequence"
        default N
        depends on SPISOFT_ENABLE
        help
            Set increasing delay values so resulting clock frequency may be noted

    config CPU_FAST
        bool "Use fast CPU clock"
        default N

endmenu
```

## Sming/Libraries/Spiffs/Kconfig
```kconfig
menu "SPIFFS"
    config SPIFF_FILEDESC_COUNT
    int "Number of file descriptors allocated"
    default 7
    help
        This sets the maximum number of files which may be opened at once. 

    config SPIFFS_OBJ_META_LEN
    int "Maximum size of file metadata"
    default 16
    help
        Maximum size of metadata which SPIFFS stores in each file index header (after the filename).
        If this value is changed, existing SPIFFS images will not be readable.

        The default value is the minimum necessary to support IFS extended file attribute information.

        The first 16 bytes are used for system attributes (e.g. modified time), so setting this to, say, 64
        leaves 48 bytes for user metadata. Each attribute has a 2-byte header (tag + size) so a single user
        attribute can be stored of up to 46 bytes, or multiple tags up to this limit.

        Note: LittleFS provides better support for user metadata.

    config SPIFF_FILES
        string "Path to source files for default spiffs volume"
        default "files"
        help
            The SPIFFS image is built using files from this directory, which must exist or the build will fail.
            If you set this to an empty value, then an empty filesystem will be created.

endmenu
```

## samples/Basic_IFS/Kconfig
```kconfig
menu "Basic IFS sample"
    config ENABLE_FLASHSTRING_IMAGE
        bool "Store filesystem image in a FlashString object instead of partition"

    config HWCONFIG
        string "Project hardware configuration"
        default "basic_ifs_$(SMING_ARCH)" if ENABLE_FLASHSTRING_IMAGE
        default "spiffs" if !ENABLE_FLASHSTRING_IMAGE
endmenu
```

## samples/HttpServer_WebSockets/Kconfig
```kconfig
#
# For a description of the syntax of this configuration file,
# see kconfig/kconfig-language.txt.
#
mainmenu "Sample Configuration"

    menu "Command Handler"
        config ENABLE_CMD_HANDLER
            bool "Enable command handler functionality"
            default y
    endmenu
```

## tests/HostTests/Kconfig
```kconfig
menu "HostTests application"
    config TEST_GROUP_INTERVAL
        int "Time in milliseconds to pause after a test group has completed"
        default 500

    config RESTART_DELAY
        int "Time in milliseconds to wait before re-starting all tests"
        default 0 if $SMING_ARCH = Host
        default 10000 if $SMING_ARCH != Host
        help
            Set to 0 to perform a system restart after all tests have completed

endmenu
```
